## drivers/platform/xiaomi/Kconfig
```kconfig
config XIAOMI_WHYRED
	default n
	bool "Custom for hardware E7S_pcb"
	help
	  Custom for E7S_pcb.

config THERMAL_SWITCH
	default n
	bool "Support themral config switch"
	help
	  Support themral config switch.
```
